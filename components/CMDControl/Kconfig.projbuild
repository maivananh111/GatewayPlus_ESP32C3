## components/CMDControl/Kconfig.projbuild
```kconfig
# put here your custom config value
menu "Command Control Configuration"
config CMD_SUPPORT_WIFI_CONTROL
    bool "WiFi control support."
    default "0"
    help
	Support WiFi control command.

config CMD_SUPPORT_HTTP_CLIENT
    bool "HTTP client support."
    default "0"
    help
	Support HTTP client command.
endmenu
```

## components/WiFi/Kconfig.projbuild
```kconfig
# put here your custom config value
menu "WiFi Configuration"
config WIFI_SSID
    string "WiFi SSID"
    default "myssid"
    help
	SSID (network name) for connect to network.

config WIFI_PASSWORD
    string "WiFi Password"
    default "mypassword"
    help
	WiFi password (WPA or WPA2) for connect to network.
endmenu
```

## components/commandline/Kconfig.projbuild
```kconfig
# put here your custom config value
menu "Command line Configuration"
config CLI_SUPPORT_WIFI_CONTROL
    bool "WiFi control support."
    default "0"
    help
	Support WiFi control command.

config CLI_SUPPORT_HTTP_CLIENT
    bool "HTTP client support."
    default "0"
    help
	Support HTTP client command.
	if CLI_SUPPORT_HTTP_CLIENT
		config CLI_SUPPORT_NUM_HTTP_CLIENT
			int "Number of client."
			default 1
			help
			Number of clients can be use.
	endif # CLI_SUPPORT_HTTP_CLIENT
endmenu
```
